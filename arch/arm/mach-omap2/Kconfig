## arch/arm/mach-omap2/Kconfig
```kconfig
comment "OMAP Core Type"
	depends on ARCH_OMAP2

config ARCH_OMAP2420
	bool "OMAP2420 support"
	depends on ARCH_OMAP2
	select OMAP_DM_TIMER
	select ARCH_OMAP_OTG

config ARCH_OMAP2430
	bool "OMAP2430 support"
	depends on ARCH_OMAP2
	select ARCH_OMAP_OTG

config ARCH_OMAP3430
	bool "OMAP3430 support"
	depends on ARCH_OMAP3
	select ARCH_OMAP_OTG

config OMAP_PACKAGE_CBC
       bool

config OMAP_PACKAGE_CBB
       bool

config OMAP_PACKAGE_CUS
       bool

config OMAP_PACKAGE_CBP
       bool

comment "OMAP Board Type"
	depends on ARCH_OMAP2PLUS

config MACH_OMAP_GENERIC
	bool "Generic OMAP board"
	depends on ARCH_OMAP2

config MACH_OMAP2_TUSB6010
	bool
	depends on ARCH_OMAP2 && ARCH_OMAP2420
	default y if MACH_NOKIA_N8X0

config MACH_OMAP_H4
	bool "OMAP 2420 H4 board"
	depends on ARCH_OMAP2
	select OMAP_DEBUG_DEVICES

config MACH_OMAP_APOLLON
	bool "OMAP 2420 Apollon board"
	depends on ARCH_OMAP2

config MACH_OMAP_2430SDP
	bool "OMAP 2430 SDP board"
	depends on ARCH_OMAP2

config MACH_OMAP3_BEAGLE
	bool "OMAP3 BEAGLE board"
	depends on ARCH_OMAP3
	select OMAP_PACKAGE_CBB

config MACH_DEVKIT8000
	bool "DEVKIT8000 board"
	depends on ARCH_OMAP3
	select OMAP_PACKAGE_CUS
	select OMAP_MUX

config MACH_OMAP_LDP
	bool "OMAP3 LDP board"
	depends on ARCH_OMAP3
	select OMAP_PACKAGE_CBB

config MACH_OVERO
	bool "Gumstix Overo board"
	depends on ARCH_OMAP3
	select OMAP_PACKAGE_CBB

config MACH_OMAP3EVM
	bool "OMAP 3530 EVM board"
	depends on ARCH_OMAP3
	select OMAP_PACKAGE_CBB

config L2CACHE_OMAP3_DISABLE
	bool "Disable level 2 cache in Aux cntrl reg"
	depends on ARCH_OMAP3
	help
		Say Y here to disable L2 cache.

config WIFI_CONTROL_FUNC
        bool "Enable WiFi control function abstraction"
        depends on ARCH_OMAP3 
        default N
        help
           Enables Power/Reset/Carddetect function abstraction

config TIWLAN_SDIO
        bool "TI WLAN Enhanced SDIO Contoller support"
        depends on MMC_OMAP || MMC_OMAP_MODULE || MMC_OMAP_HS || MMC_OMAP_HS_MODULE
        help
           Say Y here if you want to be able to use TI's WLAN device using the
           SDIO interface. If unsure, say N.
config TIWLAN_MMC_CONTROLLER
        int "MMC Controller number that TI WLAN chip is connected to"
        range 1 5
        depends on TIWLAN_SDIO
        default "5"
        help
          Choose the number of the MMC controller that TI WLAN chip is
          connected to. TI WLAN has SDIO host controller that will control
          this MMC port.

config MACH_OMAP3517EVM
	bool "OMAP3517/ AM3517 EVM board"
	depends on ARCH_OMAP3
	select OMAP_PACKAGE_CBB

config MACH_OMAP3_PANDORA
	bool "OMAP3 Pandora"
	depends on ARCH_OMAP3
	select OMAP_PACKAGE_CBB

config MACH_OMAP3_TOUCHBOOK
	bool "OMAP3 Touch Book"
	depends on ARCH_OMAP3
	select BACKLIGHT_CLASS_DEVICE

config MACH_OMAP_3430SDP
	bool "OMAP 3430 SDP board"
	depends on ARCH_OMAP3
	select OMAP_PACKAGE_CBB

config MACH_NOKIA_N800
       bool

config MACH_NOKIA_N810
       bool

config MACH_NOKIA_N810_WIMAX
       bool

config MACH_NOKIA_N8X0
	bool "Nokia N800/N810"
	depends on ARCH_OMAP2420
	select MACH_NOKIA_N800
	select MACH_NOKIA_N810
	select MACH_NOKIA_N810_WIMAX

config MACH_NOKIA_RX51
	bool "Nokia RX-51 board"
	depends on ARCH_OMAP3
	select OMAP_PACKAGE_CBB

config MACH_OMAP_ZOOM2
	bool "OMAP3 Zoom2 board"
	depends on ARCH_OMAP3
	select OMAP_PACKAGE_CBB
	select SERIAL_8250
	select SERIAL_CORE_CONSOLE
	select SERIAL_8250_CONSOLE

config MACH_OMAP_ZOOM3
	bool "OMAP3630 Zoom3 board"
	depends on ARCH_OMAP3
	select OMAP_PACKAGE_CBP
	select SERIAL_8250
	select SERIAL_CORE_CONSOLE
	select SERIAL_8250_CONSOLE
	
config MACH_LATONA
	bool "OMAP3630 LATONA board"
	depends on ARCH_OMAP3
	select OMAP_PACKAGE_CBP
	

config MACH_CM_T35
	bool "CompuLab CM-T35 module"
	depends on ARCH_OMAP3
	select OMAP_PACKAGE_CUS
	select OMAP_MUX

config MACH_IGEP0020
	bool "IGEP v2 board"
	depends on ARCH_OMAP3
	select OMAP_PACKAGE_CBB

config MACH_SBC3530
	bool "OMAP3 SBC STALKER board"
	depends on ARCH_OMAP3
	select OMAP_PACKAGE_CUS
	select OMAP_MUX

config MACH_OMAP_3630SDP
	bool "OMAP3630 SDP board"
	depends on ARCH_OMAP3
	select OMAP_PACKAGE_CBP

config OMAP4_ES1
	bool "OMAP 4430 ES1.0"
	depends on ARCH_OMAP4
	select PL310_ERRATA_588369
	select ERRATA_OMAP4_AXI2OCP
	help
	Say Y if using OMAP4430 ES1.0 samples

config MACH_OMAP_4430SDP
	bool "OMAP 4430 SDP board"
	depends on ARCH_OMAP4
	select HIGHMEM
	select TWL6030_PWM
	select TWL6030_GPADC
	select TWL6040_VIB if ANDROID_TIMED_OUTPUT && TWL6040_CODEC
	select NEW_LEDS
	select LEDS_CLASS
	select LEDS_PWM
	select LEDS_GPIO
	select LEDS_GPIO_PLATFORM
	select LEDS_OMAP4430_SDP_DISPLAY
	select LEDS_OMAP4430_SDP_KEYPAD
	select LEDS_TRIGGERS
	select LEDS_TRIGGER_TIMER
	select INPUT_CMA3000_I2C
#	select SENSORS_BH1780
	select INPUT_BH1780
	select MISC_DEVICES
#	select BMP085
	select INPUT_BMP085
	select STAGING
	select IIO
#	select SENSORS_HMC5843
	select INPUT_HMC5843
	select INPUT_SFH7741
	select HWMON
#	select SENSORS_LM75
	select INPUT_MISC
	select INPUT_KEYBOARD
	select INPUT_TOUCHSCREEN
	select TOUCHSCREEN_SYNTM12XX
	select POWER_SUPPLY
	select TWL6030_BCI_BATTERY
	select CHARGER_BQ2415x
	select SECURITY_MIDDLEWARE_COMPONENT

config MACH_OMAP4_PANDA
	bool "OMAP4 based Panda board"
	depends on ARCH_OMAP4

config ERRATA_OMAP4_AXI2OCP
	bool "OMAP 4430 axi2ocp errata workaround"
	depends on ARCH_OMAP4
	help
	Pending response counter logic is incorrectly implemented
	It decrements by only 1 even when there are 2+ responses in the
	same cycle. If 2 MCMDs send out bridge at the same time counter
	increments by.1 but when it decrement for 2 responses counter does
	not go beyond 0.
	Work-around:
	Any new request before timer max out resets the timer. With this hang
	issue will not happen.

config OMAP3_EMU
	bool "OMAP3 debugging peripherals"
	depends on ARCH_OMAP3
	select OC_ETM
	help
	  Say Y here to enable debugging hardware of omap3

config OMAP3_SDRC_AC_TIMING
	bool "Enable SDRC AC timing register changes"
	depends on ARCH_OMAP3
	default n
	help
	  If you know that none of your system initiators will attempt to
	  access SDRAM during CORE DVFS, select Y here.  This should boost
	  SDRAM performance at lower CORE OPPs.  There are relatively few
	  users who will wish to say yes at this point - almost everyone will
	  wish to say no.  Selecting yes without understanding what is
	  going on could result in system crashes;
comment "OMAP based Samsung Board Type"
	depends on ARCH_OMAP2 || ARCH_OMAP3 || ARCH_OMAP4

config MACH_OMAP_SAMSUNG
	bool "OMAP based Samsung Board"
	depends on ARCH_OMAP3 
	default n
	
config MACH_SAMSUNG_NOWPLUS
    bool "Samsung Nowplus Board"
	default y
	select MACH_OMAP_SAMSUNG
	select OMAP_PACKAGE_CBB
	depends on ARCH_OMAP3
	   
config MACH_SAMSUNG_LATONA
	bool "Samsung Latona (GT-I9003) Board"
	default n
	select MACH_OMAP_SAMSUNG
	select OMAP_PACKAGE_CBP

config MACH_SAMSUNG_ARCHER
	bool "Samsung Archer Board"
	select MACH_OMAP_SAMSUNG
	select OMAP_PACKAGE_CBB
	depends on ARCH_OMAP3

choice
    prompt "Samsung Archer Carrier"
    depends on MACH_SAMSUNG_ARCHER

    config SAMSUNG_ARCHER_TARGET_EU
        bool "Europe"
    config SAMSUNG_ARCHER_TARGET_SK
        bool "SKT"
    config SAMSUNG_ARCHER_TARGET_KT
        bool "KT"
endchoice

menu "OMAP Samsung Specific Cofigurations"
	depends on MACH_OMAP_SAMSUNG

config SAMSUNG_MODEL_NAME
        string "Samsung Model Name"
        depends on MACH_OMAP_SAMSUNG
        default ""

choice
	prompt "Samsung HW Board-Type"
	default SAMSUNG_HW_EMU_BOARD

config SAMSUNG_HW_EMU_BOARD
	bool "Samsung HW EMUL-Board"
	default n
    
config SAMSUNG_HW_REL_BOARD
	bool "Samsung HW REAL-Board"
	default y
    
endchoice

config SAMSUNG_EMU_HW_REV
	int "Samsung EMUL HW Revision"
	depends on MACH_OMAP_SAMSUNG && SAMSUNG_HW_EMU_BOARD
	default 0

config SAMSUNG_REL_HW_REV
	int "Samsung REAL HW Revision"
	depends on MACH_OMAP_SAMSUNG && SAMSUNG_HW_REL_BOARD
	default 13

config SAMSUNG_KERNEL_DEBUG
        bool "Samsung Kernel Debuging Code"
        depends on MACH_OMAP_SAMSUNG
        default n

config SAMSUNG_KERNEL_DEBUG_USER
	bool "Forced crash by key combination"
	depends on MACH_OMAP_SAMSUNG
	default n

config SAMSUNG_USE_GETLOG
	bool "Samsung getLog Debuging Feature"
	depends on MACH_OMAP_SAMSUNG
	default n
	help
		Add a MARK string to the kernel log message indicating
		starting addresses of 'FrameBuffer / printk Log buffer /
		Platform log buffer. This feature is used to extract
		debuggin information from log messages.

config SAMSUNG_ADD_GAFORENSICINFO
	bool "Samsung GAF Debuging Feature"
	depends on MACH_OMAP_SAMSUNG
	default n
	help
		Add additional information to the ram dump. This information
		will be analized in GAF Tool.

config SAMSUNG_SEMAPHORE_LOGGING
	bool "Samsung Semaphore Logging Feature"
	depends on MACH_OMAP_SAMSUNG
	default n
	help
		Add Semaphore logging feature

config SAMSUNG_PASS_PLATFORM_LOG_TO_KERNEL
	bool "Samsung Pass Platform Log to Kernel"
	depends on MACH_OMAP_SAMSUNG
	default n
	help
		This feature make a log message which is started with !@ is
		displaye through printk function.

config SAMSUNG_USE_SEC_LOG_BUF
	bool "Samsung Use SEC_LOG_BUF"
	depends on MACH_OMAP_SAMSUNG
	default n
	help
		This feature stores all serial log messages into the
		SEC_LOG_BUF area.

endmenu
config ENABLE_L3_ERRORS
	bool  "Enable L3 error logging"
	depends on ARCH_OMAP4
	default n
	help
	  Select this option to enable L3 error detection on OMAP4

config OMAP_ALLOW_OSWR
	bool  "Enable Open Switch Retention"
	depends on ARCH_OMAP4
	default n
	help
	  Select this option to enable OSWR support.
	  Which means the Logic of power domains can be lost now
	  unlike the CSWR wherein the logic is retained
```

## drivers/sensor/light/Kconfig
```kconfig
#
# LIGHT Sensor Configuration
#

config LIGHT
	bool "LIGHT Sensors"
	default y
	help
	  This option enables sensors

config OPTICAL_GP2A
	depends on I2C && GENERIC_GPIO
	tristate "GP2A ambient light and proximity input device"
	default n
	help
	  This option enables proximity & light sensors using gp2a driver.
	  
```

## drivers/sensors/Kconfig
```kconfig
# 
# Sensors core device. 
#

menuconfig SENSORS
	tristate "Sensors class support"
	help
	  Say Y here to enable Sensors class support. This allows
	  sensors monitoring by userspace
	  via sysfs and uevent (if available) and/or APM kernel interface
	  (if selected below).

if SENSORS

config SENSORS_CORE
	tristate "Sensors core"
	help
	  Say Y here to enable debugging messages for power supply class
	  and drivers.


endif # SENSORS
```

## drivers/video/omap2/displays/Kconfig
```kconfig
menu "OMAP2/3 Display Device Drivers"
        depends on OMAP2_DSS

config PANEL_GENERIC
        tristate "Generic Panel"
        help
	  Generic panel driver.
	  Used for DVI output for Beagle and OMAP3 SDP.

config PANEL_SAMSUNG_LTE430WQ_F0C
        tristate "Samsung LTE430WQ-F0C LCD Panel"
        depends on OMAP2_DSS
        help
          LCD Panel used on Overo Palo43

config PANEL_SHARP_LS037V7DW01
        tristate "Sharp LS037V7DW01 LCD Panel"
        depends on OMAP2_DSS
        help
          LCD Panel used in TI's SDP3430 and EVM boards

config PANEL_PICO_DLP
	tristate "OMAP PICO DLP Panel"
	depends on OMAP2_DSS
	help
	LCD Panel used in TI's SDP4430 and EVM boards

config PANEL_TAAL
        tristate "Taal DSI Panel"
        depends on OMAP2_DSS_DSI
        help
          Taal DSI command mode panel from TPO.

config PANEL_SHOLES
        tristate "Sholes Panel"
        help
	  LCD Panel used in sholes

config LCD_4430SDP
        tristate "OMAP4 LCD Panel"
        help
          LCD Panel used in OMAP4

config PANEL_4430SDP_TAAL
	tristate "OMAP4 LCD TAAL Panel"
	help
		DSI LCD Panel used in OMAP4

config PANEL_NEC
	tristate "NEC Panel"
	help
		LCD Panel used in the Zoom board

config PANEL_AMS
        tristate "AMS Panel"
        help
                LCD Panel used in the Archer board

config PANEL_TL2796
        tristate "Samsung tl2796 Panel"
        depends on OMAP2_DSS
        help
          Samsung tl2796 panel used on the NOWPLUS board

endmenu
```

## samsung/Kconfig
```kconfig
##
# Copyright (C) 2010, Samsung Electronics Co., Ltd. All Rights Reserved.
#  Written by System S/W Group, Open OS S/W R&D Team,
#  Mobile Communication Division.
##

##
# Project Name : Samsung Private Third-Party Device Drivers
#
# Project Description :
#
# Comments : tabstop = 8, shiftwidth = 8, noexpandtab
##

##
# File Name : Kconfig
#
# File Description :
#
# Author : Joo, Young Jin (#4349, youngjin79.joo@samsung.com)
# Dept : System S/W Group (Open OS S/W R&D Team)
# Created Date : 09-Jul-2010
# Version : Baby-Raccoon
##

menu "Samsung Private Third-Party Device Drivers"

menu "Immersion Touch Sense Driver (vibetonz)"
source "samsung/vibetonz/Kconfig"
endmenu

menu "Samsung Battery Driver"
source "samsung/battery/Kconfig"
endmenu

menu "Samsung Proximity/Light Sensor Driver"
source "samsung/PL_sensor/Kconfig"
endmenu

menu "Kionix KXSD9 Accelerometer Driver"
source "samsung/kxsd9/Kconfig"
endmenu

endmenu
```

## samsung/PL_sensor/Kconfig
```kconfig
##
# Copyright (C) 2010, Samsung Electronics, Co., Ltd. All Rights Reserved.
#  Written by System S/W Group, Open OS S/W R&D Team,
#  Mobile Communication Division.
##

##
# Project Name : Samsung Param-Partition Support for Linux Kernel
#
# Project Description :
#
# Comments : tabstop = 8, shiftwidth = 8, noexpandtab
##

##
# File Name : Kconfig
#
# File Description :
#
# Author : Joo, Young Jin (#4349, youngjin79.joo@samsung.com)
# Dept : System S/W Group (Open OS S/W R&D Team)
# Created : 19/Sep/2010
# Version : Baby-Raccoon
##

config SAMSUNG_PROXIMITY_LIGHT
	tristate "Samsung Proximity/Light Sensor Driver"
	default y
	help
		Say Y to enable Samsung Proximity/Light Sensor Driver
```

## samsung/ak8973b/Kconfig
```kconfig
##
# Project Name : Samsung Private Third-Party Device Drivers
#
# Project Description :
#
# Comments : tabstop = 8, shiftwidth = 8, noexpandtab
##

##
# File Name : Kconfig
#
# File Description :
#
# Author : System Platform2
# Dept : System S/W Group (Open OS S/W R&D Team)
# Created Date : 15/Sep/2010
# Version : Baby-Raccoon
##

config INPUT_AK8973B
	tristate "AsahiKasei AK8973B Magnetic/Compass Sensor"
	default y
	help
		AsahiKasei AK8973B Magnetic/Compass Sensor
```

## samsung/dpram_flashless/Kconfig
```kconfig
##
# Copyright (C) 2010, Samsung Electronics, Co., Ltd. All Rights Reserved.
#  Written by System S/W Group, Open OS S/W R&D Team,
#  Mobile Communication Division.
##

##
# Project Name : Samsung Param-Partition Support for Linux Kernel
#
# Project Description :
#
# Comments : tabstop = 8, shiftwidth = 8, noexpandtab
##

##
# File Name : Kconfig
#
# File Description :
#
# Author : Joo, Young Jin (#4349, youngjin79.joo@samsung.com)
# Dept : System S/W Group (Open OS S/W R&D Team)
# Created : 19/Sep/2010
# Version : Baby-Raccoon
##

config SAMSUNG_DPRAM_FLASHLESS
	tristate "Samsung Flashless Boot Support (using DPRAM)"
	default n
	help
		Say Y to enable Samsung Flashless Boot Support (using DPRAM)
```

## samsung/tbml/Kconfig
```kconfig
#
# Unified Flash Device configuration
#

menu "TinyBML Support for cramfs"

config RFS_TINYBML
	bool "Using TinyBML for Cramfs"
	help
	  cramfs using flash device

config TINY_FLASH_PHYS_ADDR
        hex "OneNAND flash Physical Location"
        depends on RFS_TINYBML 
        default "0x00000000"
        help
          This is the physical address in your flash memory the xsr will
          be linked for and stored to.  This address is dependent on your
          own flash usage.

config RFS_TINY_DEBUG
	bool
	depends on RFS_TINYBML
	default y

endmenu
```
